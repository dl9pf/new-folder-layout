## bsp/meta-rcar/meta-rcar-gen3-adas/conf/layer.conf
```bitbake
# We have a conf and classes directory, append to BBPATH
BBPATH .= ":${LAYERDIR}"

# We have a recipes directory, add to BBFILES
BBFILES += " \
    ${LAYERDIR}/recipes-*/*/*.bb \
    ${LAYERDIR}/recipes-*/*/*.bbappend \
"

BBFILE_COLLECTIONS += "rcar-gen3-adas"
BBFILE_PATTERN_rcar-gen3-adas := "^${LAYERDIR}/"
BBFILE_PRIORITY_rcar-gen3-adas = "7"

LAYERSERIES_COMPAT_rcar-gen3-adas = "dunfell"

# Distro features needed for all boards
DISTRO_FEATURES_remove = "x11"
DISTRO_FEATURES_append = " surroundview opencv-sdk"

# Distro features needed for non V3x only (default)
VAR_FEATURES = "bluetooth pulseaudio"
# Distro features needed for V3x only
VAR_FEATURES_rcar-gen3-v3x = ""
DISTRO_FEATURES_append = " ${VAR_FEATURES}"

# Is it still needed with x11 feature removed?
IMAGE_INSTALL_remove = " gtk+3-demo clutter-1.0-examples libx11-locale"

# For e2studio
EXTRA_IMAGE_FEATURES_append = " eclipse-debug"
# Extra image features rquested by Renesas
EXTRA_IMAGE_FEATURES_append = " \
    dev-pkgs \
    tools-sdk \
    tools-profile \
    tools-debug \
    package-management \
    ssh-server-openssh \
"
```

## bsp/meta-rcar/meta-rcar-gen3-adas/conf/machine/condor.conf
```bitbake
#@TYPE: Machine
#@NAME: Condor machine
#@DESCRIPTION: Machine configuration for running Condor

SOC_FAMILY = "r8a77980"

DEFAULTTUNE ?= "cortexa53"
require conf/machine/include/tune-cortexa53.inc
require conf/machine/include/${SOC_FAMILY}.inc

# 32BIT package install (default is disable)
# This variables can be used only in multilib.
USE_32BIT_PKGS ?= "0"
USE_32BIT_WAYLAND ?= "0"
USE_32BIT_MMP ?= "0"

MACHINE_FEATURES = ""

KERNEL_IMAGETYPE = "Image"
IMAGE_FSTYPES_append = " tar.bz2 ext4"

SERIAL_CONSOLE = "115200 ttySC0"

# Configuration for kernel
PREFERRED_PROVIDER_virtual/kernel = "linux-renesas"
KERNEL_DEVICETREE = "renesas/r8a77980-condor.dtb"

# Configuration for CR7 Loader
EXTRA_IMAGEDEPENDS += " cr7-loader"

# Configuration for ARM Trusted Firmware
EXTRA_IMAGEDEPENDS += " arm-trusted-firmware"

# u-boot
PREFERRED_VERSION_u-boot = "v2018.09%"
EXTRA_IMAGEDEPENDS += " u-boot"
UBOOT_MACHINE = "r8a77980_condor_defconfig"

# libdrm
PREFERRED_VERSION_libdrm = "2.4.85"

# Add variable to Build Configuration in build log
BUILDCFG_VARS_append = " SOC_FAMILY"
```

## meta-agl-cluster-demo/conf/layer.conf
```bitbake
# We have a conf and classes directory, add to BBPATH
BBPATH =. "${LAYERDIR}:"

# We have recipes-* directories, add to BBFILES
BBFILES += "${LAYERDIR}/recipes-*/*/*.bb \
            ${LAYERDIR}/recipes-*/*/*.bbappend"

BBFILE_COLLECTIONS += "agl-cluster-demo"
BBFILE_PATTERN_agl-cluster-demo = "^${LAYERDIR}/"
BBFILE_PRIORITY_agl-cluster-demo = "7"

LAYERSERIES_COMPAT_agl-cluster-demo = "dunfell"
```

## meta-agl-cluster-demo/meta-agl-profile-cluster-qt5/conf/layer.conf
```bitbake
# We have a conf and classes directory, add to BBPATH
BBPATH =. "${LAYERDIR}:"

# We have recipes-* directories, add to BBFILES
BBFILES += "${LAYERDIR}/recipes-*/*/*.bb \
            ${LAYERDIR}/recipes-*/*/*.bbappend"

BBFILE_COLLECTIONS += "aglprofileclusterqt5"
BBFILE_PATTERN_aglprofileclusterqt5 = "^${LAYERDIR}/"
BBFILE_PRIORITY_aglprofileclusterqt5 = "70"

LAYERSERIES_COMPAT_aglprofileclusterqt5 = "dunfell"
```

## meta-agl-cluster-demo/meta-agl-profile-cluster/conf/layer.conf
```bitbake
# We have a conf and classes directory, add to BBPATH
BBPATH =. "${LAYERDIR}:"

# We have recipes-* directories, add to BBFILES
BBFILES += "${LAYERDIR}/recipes-*/*/*.bb \
            ${LAYERDIR}/recipes-*/*/*.bbappend"

BBFILE_COLLECTIONS += "aglprofilecluster"
BBFILE_PATTERN_aglprofilecluster = "^${LAYERDIR}/"
BBFILE_PRIORITY_aglprofilecluster = "70"

LAYERSERIES_COMPAT_aglprofilecluster = "dunfell"
```

## meta-agl-demo/meta-agl-profile-graphical-html5/conf/layer.conf
```bitbake
# We have a conf and classes directory, add to BBPATH
BBPATH .= ":${LAYERDIR}"

# We have recipes-* directories, add to BBFILES
BBFILES += "${LAYERDIR}/recipes-*/*/*.bb \
	${LAYERDIR}/recipes-*/*/*.bbappend"

BBFILE_COLLECTIONS += "html5-framework"
BBFILE_PATTERN_html5-framework = "^${LAYERDIR}/"
BBFILE_PRIORITY_html5-framework = "80"

LAYERSERIES_COMPAT_html5-framework = "dunfell"
```

## meta-agl-demo/meta-agl-profile-graphical-qt5/conf/layer.conf
```bitbake
# We have a conf and classes directory, add to BBPATH
BBPATH =. "${LAYERDIR}:"

# We have recipes-* directories, add to BBFILES
BBFILES += "${LAYERDIR}/recipes-*/*/*.bb \
            ${LAYERDIR}/recipes-*/*/*.bbappend"

BBFILE_COLLECTIONS += "aglprofilegraphicalqt5"
BBFILE_PATTERN_aglprofilegraphicalqt5 = "^${LAYERDIR}/"
BBFILE_PRIORITY_aglprofilegraphicalqt5 = "70"

LAYERSERIES_COMPAT_aglprofilegraphicalqt5 = "dunfell"
```

## meta-agl-demo/meta-agl-profile-graphical/conf/layer.conf
```bitbake
# We have a conf and classes directory, add to BBPATH
BBPATH =. "${LAYERDIR}:"

# We have recipes-* directories, add to BBFILES
BBFILES += "${LAYERDIR}/recipes-*/*/*.bb \
            ${LAYERDIR}/recipes-*/*/*.bbappend"

BBFILE_COLLECTIONS += "aglprofilegraphical"
BBFILE_PATTERN_aglprofilegraphical = "^${LAYERDIR}/"
BBFILE_PRIORITY_aglprofilegraphical = "70"

LAYERSERIES_COMPAT_aglprofilegraphical = "dunfell"
```

## meta-agl-devel/meta-speech-framework/conf/layer.conf
```bitbake
# We have a conf and classes directory, add to BBPATH
BBPATH .= ":${LAYERDIR}"

# Let us add layer-specific bbappends which are only applied when that
# layer is included in our configuration -
# e.g. only add layers if a bsp is present.
# This is based on the BBFILE_COLLECTIONS name of the layer.
# We use either the BBFILE_COLLECTIONS name of the layer directly (meta-ti)
BBFILES += "${@' '.join('${LAYERDIR}/%s/recipes*/*/*.bbappend' % layer \
               for layer in BBFILE_COLLECTIONS.split())}"
BBFILES += "${@' '.join('${LAYERDIR}/%s/recipes*/*/*.bb' % layer \
               for layer in BBFILE_COLLECTIONS.split())}"
# or we prepend it with meta-  (e.g. rpi, fsl*)
BBFILES += "${@' '.join('${LAYERDIR}/meta-%s/recipes*/*/*.bbappend' % layer \
               for layer in BBFILE_COLLECTIONS.split())}"
BBFILES += "${@' '.join('${LAYERDIR}/meta-%s/recipes*/*/*.bb' % layer \
               for layer in BBFILE_COLLECTIONS.split())}"

# We have recipes-* directories, add to BBFILES
BBFILES += "${LAYERDIR}/recipes-*/*/*.bb \
	${LAYERDIR}/recipes-*/*/*.bbappend"

BBFILE_COLLECTIONS += "speech-framework"
BBFILE_PATTERN_speech-framework = "^${LAYERDIR}/"
BBFILE_PRIORITY_speech-framework = "8"

LAYERSERIES_COMPAT_speech-framework = "dunfell"
```

## meta-agl-telematics-demo/conf/layer.conf
```bitbake
# We have a conf and classes directory, add to BBPATH
BBPATH =. "${LAYERDIR}:"

# We have recipes-* directories, add to BBFILES
BBFILES += "${LAYERDIR}/recipes-*/*/*.bb \
            ${LAYERDIR}/recipes-*/*/*.bbappend"

BBFILE_COLLECTIONS += "agl-telematics-demo"
BBFILE_PATTERN_agl-telematics-demo = "^${LAYERDIR}/"
BBFILE_PRIORITY_agl-telematics-demo = "7"

LAYERSERIES_COMPAT_agl-telematics-demo = "dunfell"
```

## meta-agl/meta-agl-bsp/meta-rcar-gen3-adas/conf/layer.conf
```bitbake
# We have a conf and classes directory, append to BBPATH
BBPATH .= ":${LAYERDIR}"

# We have a recipes directory, add to BBFILES
# 1) the first directory symlinks necessary files out of the cogent repo
# 2) the 2nd directory is our local glue and appends
BBFILES += " \
    ${LAYERDIR}/cogent-symlinks/recipes-*/*/*.bb \
    ${LAYERDIR}/cogent-symlinks/recipes-*/*/*.bbappend \
    ${LAYERDIR}/recipes-*/*/*.bb \
    ${LAYERDIR}/recipes-*/*/*.bbappend \
"

BBFILE_COLLECTIONS += "rcar-gen3-cogent"
BBFILE_PATTERN_rcar-gen3-cogent := "^${LAYERDIR}/"
BBFILE_PRIORITY_rcar-gen3-cogent = "7"

LAYERSERIES_COMPAT_rcar-gen3-cogent = "dunfell"
```

## meta-agl/meta-agl-bsp/wic/sdimage-bootpart-uuid.wks
```
# short-description: Create SD card image with a boot partition
# long-description: Creates a partitioned SD card image. Boot files
# are located in the first vfat partition.

part /boot --source bootimg-partition --fstype=vfat --label boot --use-uuid --active --align 4 --size 16
part / --source rootfs --fstype=ext4 --label root --align 4 --use-uuid
```

## meta-agl/meta-agl-bsp/wic/systemd-intel-corei7-64-bootdisk.wks
```
# short-description: Custom EFI disk image with systemd-boot
# long-description: Creates a partitioned EFI disk image that the user
# can directly dd to boot media. The selected bootloader is systemd-boot
# and we do not have swap

part /boot --source bootimg-efi --sourceparams="loader=systemd-boot" --use-uuid --label msdos --active --align 1024

part / --source rootfs --fstype=ext4 --label platform --align 1024 --use-uuid

# Modify the append line here as needed to suit the environment.
#
# To change the default video resolution add one of the following
# resolutions:
# uvesafb.mode_option=1024x768-32
# uvesafb.mode_option=1280x1024-32
# uvesafb.mode_option=1600x1200-32
#
# To avoid corrupt boot screen by systemd message you can remove the
# console=tty0 portion below or disable all boot messages by kernel command
# line.  To disable all boot messages add:
#
# quiet
bootloader --ptable gpt --timeout=5 --append="rootwait rootfstype=ext4 console=ttyS0,115200n8 console=tty0 reboot=efi"
```

## meta-agl/meta-agl-core/conf/layer.conf
```bitbake
# We have a conf and classes directory, add to BBPATH
BBPATH =. "${LAYERDIR}:"

# We have recipes-* directories, add to BBFILES
BBFILES += "${LAYERDIR}/recipes-*/*/*.bb \
            ${LAYERDIR}/recipes-*/*/*.bbappend"

BBFILE_COLLECTIONS += "aglcore"
BBFILE_PATTERN_aglcore = "^${LAYERDIR}/"
BBFILE_PRIORITY_aglcore = "80"

LAYERSERIES_COMPAT_aglcore = "dunfell"
LAYERDEPENDS_aglcore = "core"
#LAYERDEPENDS_aglcore = "openembedded-layer"

# Sanity check for meta-virtualization layer.
# Setting SKIP_META_VIRT_SANITY_CHECK to "1" would skip the bbappend files check.
#INHERIT += "sanity-meta-agl-core"

AGL_FEATURES ??= ""
AGL_EXTRA_IMAGE_FSTYPES ??= ""
```

## meta-agl/meta-agl-distro/conf/distro/include/aarch64-tune.inc
```bitbake
# DEFAULTTUNE overrides for AGL on aarch64

# We should not need the tuning include below as the BSP should include the right set already.
# A double inclusion would produce a warning. This include line is just for reference
# include conf/machine/include/arm/arch-armv8.inc

DEFAULTTUNE = "aarch64"
# not yet ready
#QB_SYSTEM_NAME ?= "qemu-system-aarch"
#QB_DEFAULT_KERNEL ?= "zImage"
#QB_DEFAULT_FSTYPE ?= "ext4"
#QB_MACHINE ?= "-machine foo"
#QB_CPU ?= "-cpu bar"
```

## meta-agl/meta-agl-distro/conf/distro/include/arm-tune.inc
```bitbake
# DEFAULTTUNE overrides for AGL on ARM 32bit

# We should not need the tuning include below as the BSP should include the right set already.
# A double inclusion would produce a warning. This include line is just for reference
#   include conf/machine/include/arm/arch-armv7ve.inc
# medium profile boards need to
#   include conf/machine/include/arch/arm-armv7-a.inc

# Standard target for 32bit ARM (newer than cortex-a15)
AGLDEFAULTTUNE = "armv7vethf-neon-vfpv4"

# for cortex-a8, cortex-a9, cortex-a7 (=rpi 2/3)
AGLDEFAULTTUNE := "${@bb.utils.contains('DISTRO_FEATURES', 'agl-medium-arm-compiler', 'armv7athf-neon', '${AGLDEFAULTTUNE}', d)}"

# for armv6 (=rpi0/1)
AGLDEFAULTTUNE := "${@bb.utils.contains('DISTRO_FEATURES', 'agl-low-arm-compiler', 'arm1176jzfshf', '${AGLDEFAULTTUNE}', d)}"
DEFAULTTUNE := "${AGLDEFAULTTUNE}"

QB_SYSTEM_NAME ?= "qemu-system-arm"
QB_DEFAULT_KERNEL ?= "zImage"
QB_DEFAULT_FSTYPE ?= "ext4"
QB_MACHINE ?= "${@bb.utils.contains('DISTRO_FEATURES', 'agl-medium-arm-compiler', '-machine vexpress-a9', '-machine vexpress-a15', d)}"
QB_CPU ?= "${@bb.utils.contains('DISTRO_FEATURES', 'agl-medium-arm-compiler', '-cpu cortex-a9', '-cpu cortex-a15', d)}"
```

## meta-agl/meta-agl-distro/conf/distro/include/x86_64-tune.inc
```bitbake
# DEFAULTTUNE overrides for AGL on x86-64

# We should not need the tuning include below as the BSP should include the right set already.
# A double inclusion would produce a warning. This include line is just for reference
#include conf/machine/include/tune-corei7.inc
DEFAULTTUNE = "corei7-64"

# shortened copy of tune-corei7.inc due to bug in inclusion for tune-core2.inc
# TUNE_ARCH is using .= x86-64 , if done twice, you get x86-64x86-64 as TUNE_ARCH :/
# we should have at least the core2 tunings by default (=qemux86-64)

# Extra tune features
TUNEVALID[corei7] = "Enable corei7 specific processor optimizations"
TUNE_CCARGS = "${@bb.utils.contains('TUNE_FEATURES', 'corei7', ' -march=corei7 -mtune=corei7 -mfpmath=sse -msse4.2', '', d)}"

# Extra tune selections
AVAILTUNES += "corei7-32"
TUNE_FEATURES_tune-corei7-32 = "${TUNE_FEATURES_tune-x86} corei7"
BASE_LIB_tune-corei7-32 = "lib"
TUNE_PKGARCH_tune-corei7-32 = "corei7-32"
PACKAGE_EXTRA_ARCHS_tune-corei7-32 = "${PACKAGE_EXTRA_ARCHS_tune-core2-32} corei7-32"
QEMU_EXTRAOPTIONS_corei7-32 = " -cpu Nehalem,check=false"

AVAILTUNES += "corei7-64"
TUNE_FEATURES_tune-corei7-64 = "${TUNE_FEATURES_tune-x86-64} corei7"
BASE_LIB_tune-corei7-64 = "lib64"
TUNE_PKGARCH_tune-corei7-64 = "corei7-64"
PACKAGE_EXTRA_ARCHS_tune-corei7-64 = "${PACKAGE_EXTRA_ARCHS_tune-core2-64} corei7-64"
QEMU_EXTRAOPTIONS_corei7-64 = " -cpu Nehalem,check=false"

AVAILTUNES += "corei7-64-x32"
TUNE_FEATURES_tune-corei7-64-x32 = "${TUNE_FEATURES_tune-x86-64-x32} corei7"
BASE_LIB_tune-corei7-64-x32 = "libx32"
TUNE_PKGARCH_tune-corei7-64-x32 = "corei7-64-x32"
PACKAGE_EXTRA_ARCHS_tune-corei7-64-x32 = "${PACKAGE_EXTRA_ARCHS_tune-core2-64-x32} corei7-64-x32"
QEMU_EXTRAOPTIONS_corei7-64-x32 = " -cpu Nehalem,check=false"

TUNE_ARCH = "${@bb.utils.contains('TUNE_FEATURES', 'm64', '${X86ARCH64}', '' ,d)}"

# Bump qemux86-64 up to corei7
AVAILTUNES += "qemux86-64"
TUNE_FEATURES_tune-qemux86-64 = "${TUNE_FEATURES_tune-x86-64} corei7"
BASE_LIB_tune-qemux86-64 = "lib64"
TUNE_PKGARCH_tune-qemux86-64 = "corei7-64"
PACKAGE_EXTRA_ARCHS_tune-qemux86-64 = "${PACKAGE_EXTRA_ARCHS_tune-core2-64} corei7-64"
QEMU_EXTRAOPTIONS_qemux86-64 = " -cpu Nehalem,check=false"

# QEMU / runqemu options (partly overrides qemuboot-x86.inc)
QB_MACHINE = "-machine q35"
QB_SYSTEM_NAME_x86-64 = "qemu-system-x86_64"
QB_CPU_x86-64 = "-cpu qemu64,+ssse3,+sse4.1,+sse4.2,+popcnt"
QB_CPU_KVM_x86-64 = "-cpu kvm64 -cpu qemu64,+ssse3,+sse4.1,+sse4.2,+popcnt"

# Add the 'virtio-rng-pci' device otherwise the guest may run out of entropy
QB_OPT_APPEND = "-vga vmware -show-cursor -usb -device usb-tablet -device virtio-rng-pci"
```
